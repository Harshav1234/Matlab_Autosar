AUTOSAR XML (schema 00049)
package /Timing
  swc timing swc_timing: behavior=swc_IB
    timing-requirements:
      execution order constraint EOC
        ordered-elements:
          eoc executable entity ref swc_Step: executable=swc_Step, successor=swc_Step1
          eoc executable entity ref swc_Step1: executable=swc_Step1
