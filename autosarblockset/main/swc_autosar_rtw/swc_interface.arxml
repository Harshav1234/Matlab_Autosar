AUTOSAR XML (schema 00049)
package /Interfaces
  4 x sender receiver interface:
    In1_1s
      data In1_1s: category=VALUE, sw-calibration-access=READ-ONLY, type=Double
    In2_2s
      data In2_2s: category=VALUE, sw-calibration-access=READ-ONLY, type=Double
    Out1
      data Out1: category=VALUE, sw-calibration-access=READ-ONLY, type=Double
    Out2
      data Out2: category=VALUE, sw-calibration-access=READ-ONLY, type=Double
