AUTOSAR XML (schema 00049)
package /Components/SwcImplementations
  swc implementation swc_Impl: programming-language=C, sw-version=7.1.1, used-code-generator=Embedded Coder 7.9 (R2022b) 13-May-2022, vendor-id=0, behavior=swc_IB
    code-descriptors:
      code Code
        artifact-descriptors:
          short-label=swc_c, category=SWSRC
          short-label=rtwtypes_h, category=SWHDR
          short-label=swc_h, category=SWHDR
          short-label=swc_private_h, category=SWHDR
          short-label=swc_types_h, category=SWHDR
    resource consumption RsrcCons_swc
