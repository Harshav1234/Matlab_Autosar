AUTOSAR XML (schema 00047)
package /RadarFusion
  adaptive application sw component type radarService
    provide port radar_PPort: provided-interface=radar
