AUTOSAR XML (schema 00047)
package /RadarFusion
  service interface radar
    namespaces:
      symbol props RadarFusion
    events:
      data BrakeEvent: type=RadarObjects
      data ParkingBrakeEvent: type=RadarObjects
    field UpdateRate: type=UInt32, has-getter=true, has-notifier=true, has-setter=true
    methods:
      operation Adjust
        arg target_position: type=Position, direction=IN
        arg success: type=Boolean, direction=OUT
        arg effective_position: type=Position, direction=OUT
      operation Calibrate
        arg configuration: type=String, direction=IN
        arg result: type=Boolean, direction=OUT
package /RadarFusion/events
  impl type RadarObjects: category=STRUCTURE
    element active: implementation-data-type=Boolean
    element objectVector: implementation-data-type=ByteArray
package /RadarFusion/methods
  impl type Position: category=STRUCTURE
    element x: implementation-data-type=Int32
    element y: implementation-data-type=Int32
    element z: implementation-data-type=Int32
