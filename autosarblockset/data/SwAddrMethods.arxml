AUTOSAR XML (schema 4-2-1)
package /Company/Powertrain/SwAddrMethods
  7 x sw addr method, all with memory-allocation-keyword-policy=ADDR-METHOD-SHORT-NAME:
    CALIB: section-initialization-policy=NO-INIT, section-type=CALPRM
    CODE: section-type=CODE
    CONST: section-type=CONST
    VAR_CLEARED: section-initialization-policy=CLEARED, section-type=VAR
    VAR_INIT: section-initialization-policy=INIT, section-type=VAR
    VAR_NO_INIT: section-initialization-policy=NO-INIT, section-type=VAR
    VAR_POWER_ON_CLEARED: section-initialization-policy=POWER-ON-CLEARED, section-type=VAR
