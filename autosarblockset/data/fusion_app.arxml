AUTOSAR XML (schema 00047)
package /RadarFusion
  adaptive application sw component type fusion
    require port radar_RPort: required-interface=radar
