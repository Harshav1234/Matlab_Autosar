AUTOSAR XML (schema 00047)
standard types defined: boolean, sint8, sint16, sint32, sint64, uint8, uint16, uint32, uint64, sint8_least, sint16_least, sint32_least, uint8_least, uint16_least, uint32_least, float32, float64, void
