AUTOSAR XML (schema 00047)
standard types defined: Boolean, UInt8, UInt16, UInt32, Float, Double
package /ara/stdtypes
  5 x impl type:
    Int8: category=VALUE, base-type=std_int8_t
    Int16: category=VALUE, base-type=std_int16_t
    Int32: category=VALUE, base-type=std_int32_t
    String: category=VALUE, base-type=std_uint32_t
    ByteArray: category=ARRAY
      element Dim1Element: array-size=8, array-size-semantics=FIXED-SIZE, implementation-data-type=UInt8
  9 x base type, all with category=FIXED_LENGTH, base-type-encoding=NONE:
    cpp_bool: base-type-size=8, byte-order=opaque, native-declaration=bool
    std_int8_t: base-type-size=8, byte-order=little-endian, native-declaration=std::int8_t
    std_int16_t: base-type-size=16, byte-order=little-endian, native-declaration=std::int16_t
    std_int32_t: base-type-size=32, byte-order=little-endian, native-declaration=std::int32_t
    std_uint8_t: base-type-size=8, byte-order=little-endian, native-declaration=std::uint8_t
    std_uint16_t: base-type-size=16, byte-order=little-endian, native-declaration=std::uint16_t
    std_uint32_t: base-type-size=32, byte-order=little-endian, native-declaration=std::uint32_t
    cpp_float: base-type-size=32, byte-order=little-endian, native-declaration=float
    cpp_double: base-type-size=64, byte-order=little-endian, native-declaration=double
